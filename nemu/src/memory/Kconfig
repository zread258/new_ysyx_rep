## nemu/src/memory/Kconfig
```kconfig
menu "Memory Configuration"

config MROM_BASE
  hex "MROM base address"
  default 0x0        if ISA_x86
  default 0x20000000

config MROM_SIZE
  hex "MROM size"
  default 0x1000

config SRAM_BASE
  hex "SRAM base address"
  default 0x0        if ISA_x86
  default 0x0f000000

config SRAM_SIZE
  hex "SRAM size"
  default 0x2000

config PC_RESET_OFFSET
  hex "Offset of reset vector from the base of memory"
  default 0x100000 if ISA_x86
  default 0

choice
  prompt "Physical memory definition"
  default PMEM_GARRAY
config PMEM_MALLOC
  bool "Using malloc()"
config PMEM_GARRAY
  depends on !TARGET_AM
  bool "Using global array"
endchoice

config MEM_RANDOM
  depends on MODE_SYSTEM && !DIFFTEST && !TARGET_AM
  bool "Initialize the memory with random values"
  default y
  help
    This may help to find undefined behaviors.

endmenu #MEMORY
```
